## boards/shields/lg/Kconfig.defconfig
```kconfig
if SHIELD_LG_LEFT

config ZMK_KEYBOARD_NAME
    default "legendGuacamole"

config ZMK_SPLIT_ROLE_CENTRAL
    default y

endif # SHIELD_LG_LEFT

if SHIELD_LG_LEFT || SHIELD_LG_RIGHT

config ZMK_SPLIT
    default y

endif # SHIELD_LG_LEFT || SHIELD_LG_RIGHT
```

## boards/shields/lg/Kconfig.shield
```kconfig
config SHIELD_LG_LEFT
    def_bool $(shields_list_contains,lg_left)

config SHIELD_LG_RIGHT
    def_bool $(shields_list_contains,lg_right)
```
